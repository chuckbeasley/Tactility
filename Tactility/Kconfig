## Tactility/Kconfig
```kconfig
# Kconfig file for Tactility example app
menu "Tactility App"
    config TT_DEVICE_NAME
        string "Device Name"
        default ""
        help
            Human-readable device name, including vendor (e.g. "M5Stack Cardputer")
    config TT_DEVICE_NAME_SIMPLE
        string "Device Name (simple)"
        default ""
        help
            Human-readable simple device name, excluding vendor (e.g. "Cardputer")
     config TT_DEVICE_VENDOR
         string "Device Vendor Name"
         default ""
         help
             Human-readable device vendor name (e.g. "LilyGO")
     config TT_DEVICE_ID
        string "Device Identifier"
        default ""
        help
            The name of the directory in Devices/
            See https://docs.tactilityproject.org for formatting guidance.
    config TT_LAUNCHER_APP_ID
        string "Launcher App ID"
        default "tactility.launcher"
        help
            The applications that gives access to other application.
            This is the first thing that starts after the boot screen.
            The user can override it with a boot.properties file
    config TT_LVGL_FONT_SIZE_SMALL
        int "Small font size"
        default 10
        range 8 200
        help
            Small font size in pixels
    config TT_LVGL_FONT_SIZE_DEFAULT
        int "Default font size"
        default 14
        range 8 200
        help
            Default font size in pixels
    config TT_LVGL_FONT_SIZE_LARGE
        int "Large font size"
        default 18
        range 8 200
        help
            Large font size in pixels
    config TT_LVGL_STATUSBAR_ICON_SIZE
        int "Statusbar icon size"
        default 20
        range 0 200
        help
            Statusbar icon size in pixels
    config TT_LVGL_LAUNCHER_ICON_SIZE
        int "Launcher icon size"
        default 20
        range 0 200
        help
            Launcher icon size in pixels
    config TT_LVGL_SHARED_ICON_SIZE
        int "Shared icon size"
        default 16
        range 0 200
        help
            Shared icon size in pixels
    config TT_AUTO_START_APP_ID
        string "Auto Start App ID"
        default ""
        help
            An application that gets automatically started from the launcher application.
            This is optional and can be left empty.
            The user can override it from a boot.properties file.
    # T-Deck device-related code was directly referenced from Tactility in a pull request.
    # This breaks other devices because the code does not exist in those implementations.
    # Until we move it out into a proper driver, we have to have pre-processor definition for that.
    config TT_TDECK_WORKAROUND
        bool "Temporary work-around until we fix the T-Deck keyboard and trackball settings"
        default n
    choice TT_USER_DATA_LOCATION
        prompt "User Data Location"
        default TT_USER_DATA_LOCATION_INTERNAL
        help
            Where user data is stored on this device.
            "Internal Flash" assumes /data always exists.
            "SD Card" looks for the first mounted SD card at runtime and requires one to be present.
        config TT_USER_DATA_LOCATION_SD
            bool "SD Card"
        config TT_USER_DATA_LOCATION_INTERNAL
            bool "Internal Flash"
    endchoice
    config TT_SPLASH_DURATION
       int "Splash Duration (ms)"
       default 5000
       range 0 10000
       help
           The minimum time to show the splash screen in milliseconds.
           When set to 0, startup will continue to desktop as soon as boot operations are finished.
    config TT_TOUCH_CALIBRATION_SUPPORTED
        bool "Set true when a touch screen calibration app should be included"
        default n
    config TT_TOUCH_CALIBRATION_REQUIRED
        bool "Set true when a touch screen calibration is required before the device is usable"
        default n
        depends on TT_TOUCH_CALIBRATION_SUPPORTED
    config TT_IMU_SUPPORTED
        bool "Set true when the board has a QMI8658 IMU to show in Settings"
        default n
        help
            Includes the Motion app, which reads the QMI8658 through its driver and shows live
            accelerometer and gyroscope values with a tilt indicator. Set from the device's
            hardware.imu property, and only for boards that also list Drivers/qmi8658-module in
            devicetree.yaml: the app calls that driver directly, so the two have to agree or the
            build fails to link.
    config TT_APP_DEFAULT_STACK_BYTES
        int "Default app task stack, in bytes"
        default 8192
        range 2048 16384
        help
            Stack given to an app instance that does not declare one of its own (39 of the 51 apps in
            this tree today). Raise it per device with a `sdkconfig.CONFIG_TT_APP_DEFAULT_STACK_BYTES`
            line in that device's device.properties - the same override path as every other
            board-specific setting. The unit is bytes: on this tree's RISC-V targets FreeRTOS' stack
            "depth" is a byte count (portSTACK_TYPE is uint8_t), and the range's upper bound is
            APP_STACK_SIZE_MAX, the largest stack any app may ask for.

            The default is deliberately small because app stacks come from internal RAM: on this
            kernel they are never allocated in PSRAM (`CONFIG_SPIRAM_ALLOW_STACK_EXTERNAL_MEMORY` and
            `CONFIG_FREERTOS_TASK_CREATE_ALLOW_EXT_MEM` are both off for boards whose stacks may be
            touched while the cache is disabled). A board with 384 KB of SRAM and 8 MB of PSRAM can
            afford a larger one than a 4 MB board with no PSRAM at all, and apps fail to launch with
            "Failed to allocate app stack" when internal RAM runs out - so the size belongs to the
            device, not to this default. Measured on the Waveshare C5 board: 24 KB per instance left
            room for the launcher plus exactly one more app, 12 KB for several.

            What the screens actually need, from this tree's history: an LVGL list costs roughly half
            a kilobyte of stack per rendered row (the Bluetooth app overflowed at 8 KB while building
            up to 60 rows, and the Motion screen died at 1.5 KB inside LVGL's style walk). Screens
            that declare their own size ask for 2.4 KB to 12 KB, the heavier ones clustering at 4-8 KB.
endmenu
```
